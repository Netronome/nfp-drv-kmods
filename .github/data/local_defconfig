## .github/data/local_defconfig
```kconfig
CONFIG_MODULES=y
CONFIG_SMP=y
CONFIG_PCI=y
CONFIG_PCI_IOV=y
CONFIG_PCI_MSI=y
CONFIG_NET=y
CONFIG_NETDEVICES=y
CONFIG_NET_SWITCHDEV=y
CONFIG_NET_CORE=y
CONFIG_INET=y
CONFIG_VXLAN=y
CONFIG_ZLIB_INFLATE=y
CONFIG_NFP=m
CONFIG_ISO9660_FS=y
CONFIG_ZISOFS=y
CONFIG_SPARSE_RCU_POINTER=y
CONFIG_BPF_SYSCALL=y
CONFIG_TLS=y
CONFIG_TLS_DEVICE=y
```

## src/Kconfig
```kconfig
#
# Netronome device configuration
#

config NET_VENDOR_NETRONOME
	bool "Netronome(R) devices"
	default y
	---help---
	  If you have a Netronome(R) network (Ethernet) card or device, say Y.

	  Note that the answer to this question doesn't directly affect the
	  kernel: saying N will just cause the configurator to skip all
	  the questions about Netronome(R) cards. If you say Y, you will be
	  asked for your specific card in the following questions.

if NET_VENDOR_NETRONOME

# TODO: move this to a Kconfig in a nfp/ subfolder

config NFP
	tristate "Netronome(R) NFP3200/NFP6000 core driver"
	select ZLIB_INFLATE
	depends on PCI && 64BIT
	---help---
	  This driver supports basic communication and programming of
	  the Netronome(R) NFP3200 and NFP6000 flow processors.

config NFP_NET
	tristate "Netronome(R) NFP3200/NFP6000 NIC driver"
	select ZLIB_INFLATE
	depends on PCI && PCI_MSI && 64BIT
	depends on VXLAN || VXLAN=n
	---help---
	  This driver supports using Netronome(R) NFP3200/NFP6000 cards
	  as a advanced Ethernet NIC.

config NFP_NETVF
	tristate "Netronome(R) NFP4000/NFP6000 VF NIC driver"
	depends on PCI && PCI_MSI
	depends on VXLAN || VXLAN=n
	---help---
	  This driver supports SR-IOV virtual functions of
	  the Netronome(R) NFP4000/NFP6000 cards working as
	  a advanced Ethernet NIC.

config NFP_NET_DEBUG
       bool "Debug support for Netronome(R) NFP3200/NFP6000 NIC drivers"
       depends on NFP_NET || NFP_NETVF
       ---help---
	  Enable debugfs support, debug messages and extra sanity checks
	  in Netronome(R) NFP3200/NFP6000 NIC PF and VF drivers.

endif
```
